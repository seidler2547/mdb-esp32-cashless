## mdb-slave-esp32s3/main/Kconfig.projbuild
```kconfig
menu "MDB Cashless Device"

    choice
        prompt "Peripheral Addresses"
        default CASHLESS_ADDR_1

        config CASHLESS_ADDR_1
            bool "Cashless Device #1"

        config CASHLESS_ADDR_2
            bool "Cashless Device #2"

    endchoice

    config CASHLESS_DEVICE_ADDRESS
        int
        default 16 if CASHLESS_ADDR_1
        default 96 if CASHLESS_ADDR_2

    choice
        prompt "Country / Currency Code"
        default CURRENCY_UNKNOWN

        config CURRENCY_EUR
            bool "EUR - 0x0978"

        config CURRENCY_USD
            bool "USD - 0x0840"

        config CURRENCY_BRL
            bool "BRL - 0x0986"

        config CURRENCY_UNKNOWN
            bool "UNKNOWN - 0xffff"
    endchoice

    config MDB_CURRENCY_CODE
        int
        default 6520 if CURRENCY_EUR
        default 6208 if CURRENCY_USD
        default 6534 if CURRENCY_BRL
        default 65535 if CURRENCY_UNKNOWN

    choice
        prompt "Scale Factor (MDB)"
        default SCALE_FACTOR_1

        config SCALE_FACTOR_1
            bool "1"

        config SCALE_FACTOR_10
            bool "10"

        config SCALE_FACTOR_100
            bool "100"

    endchoice

    config MDB_SCALE_FACTOR
        int
        default 1 if SCALE_FACTOR_1
        default 10 if SCALE_FACTOR_10
        default 100 if SCALE_FACTOR_100

    config MDB_DECIMAL_PLACES
        int "Decimal Places (MDB)"
        default 2
        range 0 3

    config MDB_SNIFF_OTHER_CASHLESS
        bool "Sniff other cashless device (credit card detection)"
        default y
        help
            Passively listen to MDB traffic addressed to the other cashless
            device (e.g. Nayax credit card terminal). When a vend succeeds
            on that device, a CARD_SALE (0x23) is published via MQTT.
            The sniffed address is automatically set to the opposite of
            this device's address (0x10 ↔ 0x60).
            The device never transmits on the sniffed address.

    config MDB_SNIFF_ADDRESS
        int
        default 96 if CASHLESS_ADDR_1
        default 16 if CASHLESS_ADDR_2

    config MDB_DEBUG_TRACE_DEPTH
        int "Bus trace depth (9-bit words, 0 = disable)"
        default 256
        range 0 1024
        help
            Number of MDB bus bytes kept in the rolling trace ring used by
            /api/v1/mdb/trace, the MQTT trace dump and the automatic
            snapshots taken around bus errors. Each entry costs 8 bytes of
            RAM, so the default 256 entries (~0.25 s of continuous bus
            traffic) costs 2 KiB. Set to 0 to compile the trace out and
            keep only the counters.

    config MDB_DEBUG_DEFAULT_LEVEL
        int "Default MDB debug level (0-3)"
        default 2
        range 0 3
        help
            Level the firmware starts at when NVS holds no `mdb_dbg` key:
            0 = counters, address map and verdict only
            1 = + rolling byte trace
            2 = + automatic trace snapshot around bus errors (recommended)
            3 = + periodic trace dump to the serial console
            The level is settable at runtime (MQTT config cmd 0x34 or
            POST /api/v1/mdb/debug) and is then persisted in NVS.

endmenu # MDB Cashless Device

menu "SIM7080G"

    choice
        prompt "LTE Network Mode"
        default SIM7080G_CMNB_BOTH

        config SIM7080G_CMNB_CATM
            bool "Cat-M only"

        config SIM7080G_CMNB_NBIOT
            bool "NB-IoT only"

        config SIM7080G_CMNB_BOTH
            bool "Both (LTE-M + NB-IoT)"

    endchoice

    config SIM7080G_CMNB
        int
        default 1 if SIM7080G_CMNB_CATM
        default 2 if SIM7080G_CMNB_NBIOT
        default 3 if SIM7080G_CMNB_BOTH

    config SIM7080G_APN
        string "Default APN (compile-time fallback)"
        default "internet"
        help
            Default APN baked into the binary. The captive portal in P3
            allows runtime override; this value is only used if no APN is
            saved in NVS.

endmenu # SIM7080G
```
